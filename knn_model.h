#pragma once
#include <Arduino.h>
#include <pgmspace.h>

namespace SmartGymKnn {
constexpr uint8_t FEATURE_COUNT = 12;
constexpr uint8_t K_NEIGHBORS = 5;
constexpr uint16_t TRAINING_SAMPLE_COUNT = 576;

enum Label : uint8_t {
  LABEL_BICEP_BAD = 0,
  LABEL_BICEP_GOOD = 1,
  LABEL_BICEP_IDLE = 2,
  LABEL_PUSHUP_BAD = 3,
  LABEL_PUSHUP_GOOD = 4,
  LABEL_PUSHUP_IDLE = 5,
  LABEL_SQUAT_BAD = 6,
  LABEL_SQUAT_GOOD = 7,
  LABEL_SQUAT_IDLE = 8,
};

constexpr const char* LABEL_NAMES[] = {
  "bicep_bad",
  "bicep_good",
  "bicep_idle",
  "pushup_bad",
  "pushup_good",
  "pushup_idle",
  "squat_bad",
  "squat_good",
  "squat_idle",
};
constexpr uint8_t LABEL_COUNT = 9;

const float FEATURE_MEANS[FEATURE_COUNT] PROGMEM = {
  -6.00510263f,
  -0.18516409f,
  6.01460041f,
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  0.06809319f,
};

const float FEATURE_SCALES[FEATURE_COUNT] PROGMEM = {
  4.53163901f,
  3.90315649f,
  3.44605843f,
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  0.60115224f,
};

const float TRAINING_FEATURES[TRAINING_SAMPLE_COUNT][FEATURE_COUNT] PROGMEM = {
  {-0.73005404f, -0.09302930f, -0.84910934f, 0.05782101f, 0.01881789f, 0.01914164f, -0.49716066f, -0.62519680f, -0.56564154f, -0.05015885f, 0.00101597f, -0.28968567f},
  {-0.72529925f, -0.04825093f, -0.85536228f, -0.20100688f, 0.08543350f, -0.02670358f, 1.98318130f, 1.77896048f, 1.17450848f, 0.92897153f, -0.91913745f, -0.62035232f},
  {-0.73322419f, -0.05561189f, -0.89843758f, 0.01556684f, 0.01618958f, 0.01532718f, 1.71638412f, 1.75770177f, 0.59713157f, -1.23584254f, 1.21018413f, 0.52900213f},
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  {-0.72107252f, -0.06174590f, -0.79074904f, 0.09215563f, 0.06527546f, 0.09938869f, -0.44230509f, -0.17812147f, -0.59370842f, -0.00367781f, 0.03594685f, -0.14917384f},
};

const uint8_t TRAINING_LABELS[TRAINING_SAMPLE_COUNT] PROGMEM = {
  0, 0, 0, 0, 0, 0, 0, 0, 0, 0, 0, 0, 0, 0, 0, 0,
  0, 0, 0, 0, 0, 0, 0, 0, 0, 0, 0, 0, 0, 0, 0, 0,
  0, 0, 0, 0, 0, 0, 0, 0, 0, 0, 0, 0, 0, 0, 0, 0,
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  8, 8, 8, 8, 8, 8, 8, 8, 8, 8, 8, 8, 8, 8, 8, 8,
};

inline uint8_t predict(const float features[FEATURE_COUNT]) {
  float nearestDistances[K_NEIGHBORS];
  uint8_t nearestLabels[K_NEIGHBORS];
  for (uint8_t neighbor = 0; neighbor < K_NEIGHBORS; ++neighbor) {
    nearestDistances[neighbor] = INFINITY;
    nearestLabels[neighbor] = 0;
  }

  for (uint16_t sample = 0; sample < TRAINING_SAMPLE_COUNT; ++sample) {
    float distance = 0.0f;
    for (uint8_t feature = 0; feature < FEATURE_COUNT; ++feature) {
      const float value = (features[feature] - pgm_read_float(&FEATURE_MEANS[feature])) / pgm_read_float(&FEATURE_SCALES[feature]);
      const float difference = value - pgm_read_float(&TRAINING_FEATURES[sample][feature]);
      distance += difference * difference;
    }
    uint8_t insertion = K_NEIGHBORS;
    for (uint8_t neighbor = 0; neighbor < K_NEIGHBORS; ++neighbor) {
      if (distance < nearestDistances[neighbor]) {
        insertion = neighbor;
        break;
      }
    }
    if (insertion < K_NEIGHBORS) {
      for (uint8_t neighbor = K_NEIGHBORS - 1; neighbor > insertion; --neighbor) {
        nearestDistances[neighbor] = nearestDistances[neighbor - 1];
        nearestLabels[neighbor] = nearestLabels[neighbor - 1];
      }
      nearestDistances[insertion] = distance;
      nearestLabels[insertion] = pgm_read_byte(&TRAINING_LABELS[sample]);
    }
  }

  uint8_t votes[sizeof(LABEL_NAMES) / sizeof(LABEL_NAMES[0])] = {};
  for (uint8_t neighbor = 0; neighbor < K_NEIGHBORS; ++neighbor) {
    ++votes[nearestLabels[neighbor]];
  }
  uint8_t bestLabel = 0;
  for (uint8_t label = 1; label < sizeof(LABEL_NAMES) / sizeof(LABEL_NAMES[0]); ++label) {
    if (votes[label] > votes[bestLabel]) {
      bestLabel = label;
    }
  }
  return bestLabel;
}

inline const char* labelName(uint8_t label) {
  return label < sizeof(LABEL_NAMES) / sizeof(LABEL_NAMES[0]) ? LABEL_NAMES[label] : "unknown";
}
}  // namespace SmartGymKnn
